ASAP2_VERSION 1 71
/begin PROJECT SYNTHETIC "ECU Studio training set"
/begin MODULE ECU "Fictional demo only"
/begin MOD_COMMON "Demo byte order" BYTE_ORDER MSB_FIRST /end MOD_COMMON
/begin RECORD_LAYOUT RL_UBYTE FNC_VALUES 1 UBYTE ROW_DIR DIRECT /end RECORD_LAYOUT
/begin RECORD_LAYOUT RL_UWORD FNC_VALUES 1 UWORD ROW_DIR DIRECT /end RECORD_LAYOUT
/begin RECORD_LAYOUT RL_SWORD FNC_VALUES 1 SWORD ROW_DIR DIRECT /end RECORD_LAYOUT
/begin RECORD_LAYOUT RL_ULONG FNC_VALUES 1 ULONG ROW_DIR DIRECT /end RECORD_LAYOUT
/begin CHARACTERISTIC BOOST_REQUEST "Boost pressure target" MAP 0x801000 RL_UWORD 0 NO_COMPU_METHOD 0 65535 MATRIX_DIM 16 16 1
 /begin AXIS_DESCR FIX_AXIS RPM NO_COMPU_METHOD 16 0 16000 FIX_AXIS_PAR_DIST 0 1000 16 /end AXIS_DESCR
 /begin AXIS_DESCR FIX_AXIS LOAD NO_COMPU_METHOD 16 0 200 FIX_AXIS_PAR_DIST 0 10 16 /end AXIS_DESCR
/end CHARACTERISTIC
/begin CHARACTERISTIC EGR_RATE "AGR EGR rate reference" MAP 0x801500 RL_UWORD 0 NO_COMPU_METHOD 0 65535 MATRIX_DIM 16 16 1
 /begin AXIS_DESCR FIX_AXIS RPM NO_COMPU_METHOD 16 0 16000 FIX_AXIS_PAR_DIST 0 1000 16 /end AXIS_DESCR
 /begin AXIS_DESCR FIX_AXIS LOAD NO_COMPU_METHOD 16 0 200 FIX_AXIS_PAR_DIST 0 10 16 /end AXIS_DESCR
/end CHARACTERISTIC
/begin CHARACTERISTIC TORQUE_MAX "Torque limiter" MAP 0x802000 RL_UWORD 0 NO_COMPU_METHOD 0 65535 MATRIX_DIM 16 16 1
 /begin AXIS_DESCR FIX_AXIS RPM NO_COMPU_METHOD 16 0 16000 FIX_AXIS_PAR_DIST 0 1000 16 /end AXIS_DESCR
 /begin AXIS_DESCR FIX_AXIS LOAD NO_COMPU_METHOD 16 0 200 FIX_AXIS_PAR_DIST 0 10 16 /end AXIS_DESCR
/end CHARACTERISTIC
/begin CHARACTERISTIC INJECTION_QUANTITY "Injection duration example" MAP 0x802800 RL_UWORD 0 NO_COMPU_METHOD 0 65535 MATRIX_DIM 16 16 1
 /begin AXIS_DESCR FIX_AXIS RPM NO_COMPU_METHOD 16 0 16000 FIX_AXIS_PAR_DIST 0 1000 16 /end AXIS_DESCR
 /begin AXIS_DESCR FIX_AXIS LOAD NO_COMPU_METHOD 16 0 200 FIX_AXIS_PAR_DIST 0 10 16 /end AXIS_DESCR
/end CHARACTERISTIC
/begin CHARACTERISTIC IGNITION_ADVANCE "Ignition spark angle example" MAP 0x803000 RL_SWORD 0 NO_COMPU_METHOD 0 65535 MATRIX_DIM 16 16 1
 /begin AXIS_DESCR FIX_AXIS RPM NO_COMPU_METHOD 16 0 16000 FIX_AXIS_PAR_DIST 0 1000 16 /end AXIS_DESCR
 /begin AXIS_DESCR FIX_AXIS LOAD NO_COMPU_METHOD 16 0 200 FIX_AXIS_PAR_DIST 0 10 16 /end AXIS_DESCR
/end CHARACTERISTIC
/begin CHARACTERISTIC LAMBDA_TARGET "Lambda air-fuel target" MAP 0x803800 RL_UWORD 0 NO_COMPU_METHOD 0 65535 MATRIX_DIM 16 16 1
 /begin AXIS_DESCR FIX_AXIS RPM NO_COMPU_METHOD 16 0 16000 FIX_AXIS_PAR_DIST 0 1000 16 /end AXIS_DESCR
 /begin AXIS_DESCR FIX_AXIS LOAD NO_COMPU_METHOD 16 0 200 FIX_AXIS_PAR_DIST 0 10 16 /end AXIS_DESCR
/end CHARACTERISTIC
/begin CHARACTERISTIC WASTEGATE_REQUEST "Wastegate turbo control" MAP 0x804000 RL_UWORD 0 NO_COMPU_METHOD 0 65535 MATRIX_DIM 16 16 1
 /begin AXIS_DESCR FIX_AXIS RPM NO_COMPU_METHOD 16 0 16000 FIX_AXIS_PAR_DIST 0 1000 16 /end AXIS_DESCR
 /begin AXIS_DESCR FIX_AXIS LOAD NO_COMPU_METHOD 16 0 200 FIX_AXIS_PAR_DIST 0 10 16 /end AXIS_DESCR
/end CHARACTERISTIC
/begin CHARACTERISTIC IDLE_SPEED_REQUEST "Idle speed" CURVE 0x804800 RL_UWORD 0 NO_COMPU_METHOD 0 65535 MATRIX_DIM 16 1 1
 /begin AXIS_DESCR FIX_AXIS LOAD NO_COMPU_METHOD 16 0 200 FIX_AXIS_PAR_DIST 0 10 16 /end AXIS_DESCR
/end CHARACTERISTIC
/begin CHARACTERISTIC THERMAL_PROTECTION "Temperature protection" MAP 0x805000 RL_UWORD 0 NO_COMPU_METHOD 0 65535 MATRIX_DIM 16 16 1
 /begin AXIS_DESCR FIX_AXIS RPM NO_COMPU_METHOD 16 0 16000 FIX_AXIS_PAR_DIST 0 1000 16 /end AXIS_DESCR
 /begin AXIS_DESCR FIX_AXIS LOAD NO_COMPU_METHOD 16 0 200 FIX_AXIS_PAR_DIST 0 10 16 /end AXIS_DESCR
/end CHARACTERISTIC
/begin CHARACTERISTIC RAIL_PRESSURE_REQUEST "Rail pressure request" MAP 0x805800 RL_UWORD 0 NO_COMPU_METHOD 0 65535 MATRIX_DIM 16 16 1
 /begin AXIS_DESCR FIX_AXIS RPM NO_COMPU_METHOD 16 0 16000 FIX_AXIS_PAR_DIST 0 1000 16 /end AXIS_DESCR
 /begin AXIS_DESCR FIX_AXIS LOAD NO_COMPU_METHOD 16 0 200 FIX_AXIS_PAR_DIST 0 10 16 /end AXIS_DESCR
/end CHARACTERISTIC
/begin CHARACTERISTIC DRIVER_WISH_PEDAL "Driver wish pedal position" MAP 0x806000 RL_UWORD 0 NO_COMPU_METHOD 0 65535 MATRIX_DIM 16 16 1
 /begin AXIS_DESCR FIX_AXIS RPM NO_COMPU_METHOD 16 0 16000 FIX_AXIS_PAR_DIST 0 1000 16 /end AXIS_DESCR
 /begin AXIS_DESCR FIX_AXIS LOAD NO_COMPU_METHOD 16 0 200 FIX_AXIS_PAR_DIST 0 10 16 /end AXIS_DESCR
/end CHARACTERISTIC
/begin CHARACTERISTIC SMOKE_LIMITER "Smoke limiter" MAP 0x806800 RL_UWORD 0 NO_COMPU_METHOD 0 65535 MATRIX_DIM 16 16 1
 /begin AXIS_DESCR FIX_AXIS RPM NO_COMPU_METHOD 16 0 16000 FIX_AXIS_PAR_DIST 0 1000 16 /end AXIS_DESCR
 /begin AXIS_DESCR FIX_AXIS LOAD NO_COMPU_METHOD 16 0 200 FIX_AXIS_PAR_DIST 0 10 16 /end AXIS_DESCR
/end CHARACTERISTIC
/begin CHARACTERISTIC NOX_MODEL "NOx model (fictional)" CURVE 0x807000 RL_UBYTE 0 NO_COMPU_METHOD 0 65535 MATRIX_DIM 16 1 1
 /begin AXIS_DESCR FIX_AXIS LOAD NO_COMPU_METHOD 16 0 200 FIX_AXIS_PAR_DIST 0 10 16 /end AXIS_DESCR
/end CHARACTERISTIC
/begin CHARACTERISTIC DIAGNOSTIC_THRESHOLD "Diagnostic threshold" VALUE 0x807200 RL_ULONG 0 NO_COMPU_METHOD 0 65535 MATRIX_DIM 1 1 1 /end CHARACTERISTIC
/end MODULE
/end PROJECT
